/* Copyright (c) 2016-2017, The Linux Foundation. All rights reserved.
 *
 * This program is free software; you can redistribute it and/or modify
 * it under the terms of the GNU General Public License version 2 and
 * only version 2 as published by the Free Software Foundation.
 *
 * This program is distributed in the hope that it will be useful,
 * but WITHOUT ANY WARRANTY; without even the implied warranty of
 * MERCHANTABILITY or FITNESS FOR A PARTICULAR PURPOSE.  See the
 * GNU General Public License for more details.
 */

/* Disable WLED */
&pm660l_wled {
//#ifndef VENDOR_EDIT
//caiwutang@MM.Display.LCD.featrue, 2019/03/29, Modify for WLED
//	status = "disabled";
//#else /* VENDOR_EDIT */
	status = "okay";
//#endif /* VENDOR_EDIT */
};

/* disable LCDB */
&pm660l_lcdb {
//#ifndef VENDOR_EDIT
//caiwutang@MM.Display.LCD.featrue, 2019/03/29, Modify for WLED
//	status = "disabled";
//#else /* VENDOR_EDIT */
	status = "okay";
//#endif /* VENDOR_EDIT */
};

&pm660a_oledb {
	status = "okay";
};

&pm660a_labibb {
	status = "okay";
};
