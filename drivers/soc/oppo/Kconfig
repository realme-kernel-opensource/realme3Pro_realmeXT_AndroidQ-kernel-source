## drivers/soc/oppo/Kconfig
```kconfig
# ifdef VENDOR_EDIT 
# yixue.ge add for config oppo software common soft
config OPPO_ARCH_FILE
	bool "for build directory oppo"
	---help---
	say Y to buid in

config OPPO_COMMON_SOFT
      bool "config oppo common software"
	  select OPPO_ARCH_FILE
	  help
		define this config to get project verion from sharemem.
		Maybe this value is from CDT or dynamic identify by hardware
		id.

config OPPO_DEVICE_IFNO
      bool "config oppo devinfo"
	  select OPPO_ARCH_FILE
	  help
		define this config to compile devinfo.c for device register
		.
source "drivers/soc/oppo/oppo_project/Kconfig"

source "drivers/soc/oppo/oppo_devinfo/Kconfig"

source "drivers/soc/oppo/oppo_trace/Kconfig"
source "drivers/soc/oppo/oppo_mdmrst/Kconfig"

source "drivers/soc/oppo/oppo_hypnus/Kconfig"

#ifdef VENDOR_EDIT
#//John.Xu@PhoneSw.AudioDriver, 2016/02/22, Add for critical_log
#source "drivers/soc/oppo/oppo_criticallog/Kconfig"
#endif /* VENDOR_EDIT */

#ifdef VENDOR_EDIT
#//wenbin.liu@PSW.Kernel.MM, 2018/05/23, Add for Healthinfo monitor
source "drivers/soc/oppo/oppo_healthinfo/Kconfig"
#endif /* VENDOR_EDIT */

#ifdef VENDOR_EDIT
#//Wen.Luo@BSP
source "drivers/soc/oppo/oppo_shutdown_detect/Kconfig"
#endif /* VENDOR_EDIT */

#Kun.Hu@TECH.BSP.Stability.PHOENIX_PROJECT 2019/06/15, Add for PHOENIX_PROJECT
source "drivers/soc/oppo/oppo_phoenix/Kconfig"

#ifdef VENDOR_EDIT
#GaoTing.Gan@PSW.MultiMedia.MediaServer, 2019/03/07, Add for kevent feedback
source "drivers/soc/oppo/oppo_kevent_feedback/Kconfig"
#endif /* VENDOR_EDIT */
```

## drivers/soc/oppo/oppo_shutdown_detect/Kconfig
```kconfig
#ifdef VENDOR_EDIT
#Wen.Luo@PSW.Kernel.Stability, 2018/05/23, Add for oppo_shutdown_detect monitor
config OPPO_SHUTDOWN_DETECT
	bool "OPPO shutdown hang detect"
	default y
	help
	  define this config to init oppo oppo_shutdown_detect.
#endif /* VENDOR_EDIT */
```
